## boards/arm/ble_micro_pro/Kconfig.ble_micro_pro
```kconfig
# SPDX-License-Identifier: MIT

config BOARD_BLE_MICRO_PRO
    select SOC_NRF52840_QIAA
```

## boards/arm/ble_micro_pro/board.yml
```yaml
board:
  name: ble_micro_pro
  vendor: sekigon
  socs:
    - name: nrf52840
  revision:
    format: major.minor.patch
    default: 1.0.0
    revisions:
      - name: 1.0.0
```
